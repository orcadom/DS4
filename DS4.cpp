/*
DS4.h - Dualshock 4 wired controller emulator
Created by Dominic Houghton, 10th July, 2024.
Released into the public domain.
Change boards.txt for you board for proper usb emulation:
vid.0=0x054C
pid.0=0x05C4
*/

#include "Arduino.h"
#include "DS4.h"

DS4::DS4()
{
    _count = 0;
    _autoSend = true;
    for(int i = 0; i < DS4_BUTTONS; i++){
        _buttonState[i] = false;
    }
    _hatDirection = 8;
    for(int i = 0; i < DS4_AXES; i++){
        _axisPosition[i] = 127;
    }
    for(int i = 0; i < DS4_TRIGGERS; i++){
        _triggerPosition[i] = 0;
    }
    _batteryLevel = 100;
    _plugConnected = true;
}

void DS4::begin()
{
    static const uint8_t reportDescriptor[DS4_REPORT_SIZE] PROGMEM = {
        0x05,0x01,
        0x09,0x05,
        0xA1,0x01,
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        0xB1,0x02,
        0xC0
    };
    static HIDSubDescriptor node(reportDescriptor, DS4_REPORT_SIZE);
	HID().AppendDescriptor(&node);
    send();
}

void DS4::send()
{   
    //Template
    uint8_t outputData[] = {
              0x00, 0x00, 0x00, 0x00, 0x00, 0x00, 0x00,
        0x00, 0x00, 0x00, 0x00, 0xFD, 0x00, 0x00, 0x00,
        0x00, 0x00, 0x00, 0x00, 0x00, 0x00, 0x00, 0x00,
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        0x00, 0x80, 0x00, 0x00, 0x00, 0x00, 0x80, 0x00
    };

    outputData[0] = _axisPosition[0]; // Left Stick X
    outputData[1] = _axisPosition[1]; // Left Stick Y
    outputData[2] = _axisPosition[2]; // Right Stick X
    outputData[3] = _axisPosition[3]; // Right Stick Y

    outputData[4] = _hatDirection; // Hat

    bitWrite(outputData[4], 7, _buttonState[0]); // Triangle
    bitWrite(outputData[4], 6, _buttonState[1]); // Circle
    bitWrite(outputData[4], 5, _buttonState[2]); // X
    bitWrite(outputData[4], 4, _buttonState[3]); // Square

    bitWrite(outputData[5], 0, _buttonState[4]); // L1
    bitWrite(outputData[5], 1, _buttonState[5]); // R1
    bitWrite(outputData[5], 2, _buttonState[6]); // L2
    bitWrite(outputData[5], 3, _buttonState[7]); // R2
    bitWrite(outputData[5], 4, _buttonState[8]); // Share
    bitWrite(outputData[5], 5, _buttonState[9]); // Options
    bitWrite(outputData[5], 6, _buttonState[10]); // L3
    bitWrite(outputData[5], 7, _buttonState[11]); // R3

    bitWrite(outputData[6], 0, _buttonState[12]); // PS
    bitWrite(outputData[6], 1, _buttonState[13]); // Track Pad

    outputData[6] = (_count << 2) + outputData[6];

    outputData[7] = _triggerPosition[0]; // L2
    outputData[8] = _triggerPosition[1]; // R2

    uint16_t time = millis();

    outputData[9] = time >> 8;
    outputData[10] = time;

    // Battery
    outputData[29] = _batteryLevel / 10;
    bitWrite(outputData[29], 4, _plugConnected);
    
    HID().SendReport(0x01, outputData, DS4_OUTPUT_SIZE);

    _count++;
}

void DS4::setAutoSend(bool autoSend)
{
    _autoSend = autoSend;
}

void DS4::setButton(uint8_t button, bool state)
{
    _buttonState[button] = state;
    if(_autoSend)
    {
        send();
    }
}

void DS4::setHat(uint8_t direction)
{
    _hatDirection = direction;
    if(_autoSend)
    {
        send();
    }
}

void DS4::setAxis(uint8_t axis, uint8_t position)
{
    _axisPosition[axis] = position;
    if(_autoSend)
    {
        send();
    }
}

void DS4::setTrigger(uint8_t trigger, uint8_t position)
{
    _triggerPosition[trigger] = position;
    if(trigger == 0){
        _buttonState[DS4_L2] = position > 0;
    }else{
        _buttonState[DS4_R2] = position > 0;
    }
    if(_autoSend)
    {
        send();
    }
}

void DS4::setBattery(uint8_t level, bool plugConnected)
{
    _batteryLevel = level;
    _plugConnected = plugConnected;
    if(_autoSend)
    {
        send();
    }
}
